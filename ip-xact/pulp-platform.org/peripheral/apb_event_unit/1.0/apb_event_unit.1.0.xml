# apb_event_unit: IP-XACT component
VLNV pulp-platform.org:peripheral:apb_event_unit:1.0

## Parameters
APB_ADDR_WIDTH = 12 — APB slaves are 4KB by default

## Bus interfaces (logical=physical port)
irq: system pulp-platform.org:interface:irq:1.0
  event=event_i, irq=irq_i
apb_slave: slave amba.com:AMBA3:APB:r1p0_4, memory map EVENT_UNIT
  PADDR[11:0]=PADDR, PSELx[0:0]=PSEL[0:0], PENABLE[0:0]=PENABLE[0:0], PWRITE[0:0]=PWRITE[0:0], PRDATA=PRDATA, PWDATA=PWDATA, PREADY[0:0]=PREADY[0:0], PSLVERR[0:0]=PSLVERR[0:0]

## Ports
in PADDR[APB_ADDR_WIDTH-1:0]
in PSEL
in PENABLE
in PWRITE
out PRDATA[31:0]
in PWDATA[31:0]
out PREADY
out PSLVERR
in clk_i — clk bypass for synch ff
in HCLK
in HRESETn
in irq_i[31:0]
in event_i[31:0]
out irq_o[31:0]
in fetch_enable_i
out fetch_enable_o
out clk_gate_core_o — output to core's clock gate to
in core_busy_i

## Address spaces and blocks
eventinteruptunit.event_unit_registers: base 'h0, range 'h28, width 32

## Registers
Registers are 32-bit, access not given, no defined reset value unless marked. A register's access mark holds for its fields unless they carry their own. Offsets are from the block's base; lines under a group give offsets from that group; [hi:lo] are bit positions; {n}, {i} and the like mark numbered series; 'fields as' and 'values as' point back to an identical list; <NAME> marks a mode.

## eventinteruptunit.event_unit_registers
Base 0x00000000
0x00 IER
  [31:0] E
0x04 IPR
  [31:0] P
0x08 ISP
  [31:0] S
0x0C ICP
  [31:0] C
0x10 EER
  [31:0] E
0x14 EPR
  [31:0] P
0x18 ESP
  [31:0] S
0x1C ECP
  [31:0] C
0x20 SCR
  [0] E
0x24 SSR
  [0] S
